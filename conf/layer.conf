## conf/layer.conf
```bitbake
# We have a conf and classes directory, add to BBPATH
BBPATH .= ":${LAYERDIR}"

# We have a packages directory, add to BBFILES
BBFILES += "${LAYERDIR}/recipes-*/*/*.bb \
            ${LAYERDIR}/recipes-*/*/*.bbappend"

BBFILE_COLLECTIONS += "efl-layer"
BBFILE_PATTERN_efl-layer:= "^${LAYERDIR}/"
BBFILE_PRIORITY_efl-layer = "4"
LAYERVERION_efl-layer = "1"

LAYERDEPENDS_efl-layer = "core"

E_RELEASES = "https://download.enlightenment.org/rel"
```
